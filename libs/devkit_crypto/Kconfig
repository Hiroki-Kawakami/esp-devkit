## libs/usb_device/Kconfig
```kconfig
menu "USB device"

config USBD
    bool "USB device stack"
    depends on DEVKIT_SIMULATOR || SOC_USB_OTG_SUPPORTED
    default n
    help
        Device stack for the DWC2 controller, with functions composed into one
        configuration. On the simulator the controller is a USB/IP server.

config USBD_VENDOR
    bool "Vendor-specific function"
    depends on USBD
    default n
    help
        One vendor-specific interface with bulk endpoints.

config USBD_UAC
    bool "USB Audio Class 2.0 speaker"
    depends on USBD
    default n
    help
        An isochronous audio stream from the host, with mute and volume.

config USBD_HID
    bool "HID function"
    depends on USBD
    default n
    help
        One HID interface with an interrupt IN endpoint, as a boot keyboard,
        a boot mouse or with a report descriptor of the caller's.

endmenu
```

## libs/usb_host/Kconfig
```kconfig
menu "USB host"

config USBH
    bool

config USBH_MSC
    bool "Mass storage class driver"
    depends on DEVKIT_SIMULATOR || SOC_USB_OTG_SUPPORTED
    select USBH
    default n
    help
        Bulk-Only Transport drives with a SCSI command set, mounted through
        FatFS. On the simulator a host directory stands in for the drive.

config USBH_UAC
    bool "Audio class driver (playback)"
    depends on DEVKIT_SIMULATOR || SOC_USB_OTG_SUPPORTED
    select USBH
    default n
    help
        USB Audio Class 1.0 playback to adaptive and synchronous endpoints.
        On the simulator a WAV file stands in for the device.

config USBH_UVC
    bool "Video class driver (MJPEG capture)"
    depends on DEVKIT_SIMULATOR || SOC_USB_OTG_SUPPORTED
    select USBH
    default n
    help
        USB Video Class MJPEG streams over isochronous or bulk endpoints,
        assembled into caller-provided frame slots. On the simulator JPEG
        files stand in for the camera.

endmenu
```

## ui_framework/Kconfig
```kconfig
menu "UI Framework"

choice UI_FRAMEWORK_WIDGETS_IMPLEMENTATION
    prompt "Widgets implementation"
    default UI_FRAMEWORK_WIDGETS_PAPER if BSP_BOARD_PAPER || BSP_BOARD_PAPER_S3 || BSP_BOARD_LILYGO_T5
    default UI_FRAMEWORK_WIDGETS_TAB5 if BSP_BOARD_TAB5
    default UI_FRAMEWORK_WIDGETS_NONE

    config UI_FRAMEWORK_WIDGETS_TAB5
        bool "Tab5 widgets"
        help
            Build the Tab5-specific modal and navigation implementations.

    config UI_FRAMEWORK_WIDGETS_PAPER
        bool "Paper widgets"
        help
            Build the M5Paper and M5PaperS3 modal and navigation implementations.

    config UI_FRAMEWORK_WIDGETS_CUSTOM
        bool "Application-provided widgets"
        help
            Build only the common widget helpers. The application provides the
            modal and navigation implementations declared by ui_framework.

    config UI_FRAMEWORK_WIDGETS_NONE
        bool "No styled widgets"
        help
            Do not build modal or navigation implementations. Common layout
            helpers remain available.
endchoice

endmenu
```
