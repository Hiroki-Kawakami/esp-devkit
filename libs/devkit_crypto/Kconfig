## libs/devkit_crypto/Kconfig
```kconfig
menu "devkit_crypto"

config DEVKIT_CRYPTO_MBEDTLS
    bool
    default y
    select MBEDTLS_AES_C
    select MBEDTLS_GCM_C
    select MBEDTLS_CHACHA20_C
    select MBEDTLS_CHACHAPOLY_C
    select MBEDTLS_ECP_C
    select MBEDTLS_ECP_DP_SECP256R1_ENABLED
    select MBEDTLS_ECP_DP_SECP384R1_ENABLED
    select MBEDTLS_ECP_DP_SECP521R1_ENABLED
    select MBEDTLS_ECP_DP_CURVE25519_ENABLED
    select MBEDTLS_ECDH_C
    select MBEDTLS_ECDSA_C
    select MBEDTLS_RSA_C
    select MBEDTLS_PKCS1_V15
    select MBEDTLS_PKCS1_V21
    select MBEDTLS_SHA1_C
    select MBEDTLS_SHA256_C
    select MBEDTLS_SHA384_C
    select MBEDTLS_SHA512_C
    select MBEDTLS_THREADING_C

choice DEVKIT_CRYPTO_CA_BUNDLE
    prompt "Default CA bundle"
    default DEVKIT_CRYPTO_CA_BUNDLE_NONE
    help
        Mozilla's roots, as the dev shell's DEVKIT_CA_BUNDLE holds them, for
        x509::TrustStore::default_bundle().

config DEVKIT_CRYPTO_CA_BUNDLE_NONE
    bool "None"

config DEVKIT_CRYPTO_CA_BUNDLE_EMBEDDED
    bool "Embedded in the app"
    help
        Changes only with the firmware; ca_bundle::install is unsupported.

config DEVKIT_CRYPTO_CA_BUNDLE_PARTITION
    bool "In a data partition"
    help
        Written by `idf.py flash` and replaceable at run time with
        ca_bundle::install. The partition holds two copies of the bundle
        plus 8 KiB; 192 KiB leaves room to grow.

endchoice

config DEVKIT_CRYPTO_CA_PARTITION
    string "CA bundle partition label"
    depends on DEVKIT_CRYPTO_CA_BUNDLE_PARTITION
    default "ca_bundle"

endmenu
```

## libs/devkit_net/Kconfig
```kconfig
menu "devkit_net"

config DEVKIT_NET_WIFI
    bool "Built-in Wi-Fi"
    depends on SOC_WIFI_SUPPORTED
    default y
    help
        Registers the chip's own Wi-Fi as the station interface "sta".

config DEVKIT_NET_IRAM_OPT
    bool "Place the per-packet path in IRAM"
    default n
    help
        Runs the code every frame goes through from internal RAM instead of
        flash, at the cost of that much heap. Worth it where flash cache
        misses dominate, as on chips with a small instruction cache.

endmenu
```

## libs/esp_hosted_enhanced/Kconfig
```kconfig
menu "esp_hosted_enhanced"

config ESP_HOSTED_ENHANCED_HOST
    bool "Wi-Fi remote host over SDIO"
    depends on ESP_WIFI_REMOTE_LIBRARY_CUSTOM
    default y
    help
        Implement the esp_wifi_remote API against an esp-hosted 2.12
        compatible coprocessor on an SDIO slot.

if ESP_HOSTED_ENHANCED_HOST

config ESP_HOSTED_ENHANCED_SDIO_SLOT
    int "SDMMC slot"
    default 1

config ESP_HOSTED_ENHANCED_SDIO_FREQ_KHZ
    int "SDIO clock (kHz)"
    default 40000

config ESP_HOSTED_ENHANCED_PIN_CLK
    int "CLK GPIO"

config ESP_HOSTED_ENHANCED_PIN_CMD
    int "CMD GPIO"

config ESP_HOSTED_ENHANCED_PIN_D0
    int "D0 GPIO"

config ESP_HOSTED_ENHANCED_PIN_D1
    int "D1 GPIO"

config ESP_HOSTED_ENHANCED_PIN_D2
    int "D2 GPIO"

config ESP_HOSTED_ENHANCED_PIN_D3
    int "D3 GPIO"

config ESP_HOSTED_ENHANCED_PIN_RESET
    int "Coprocessor EN GPIO (-1: not wired)"
    default -1

endif

endmenu
```

## libs/harness/Kconfig
```kconfig
menu "Test harness"

config HARNESS
    bool "Scripted UI test harness" if !DEVKIT_SIMULATOR
    default y if DEVKIT_SIMULATOR
    default n
    select BSP_HARNESS
    help
        Compile the harness.h line protocol and its transport (IDF log console
        on device, stdin/stdout on the host) so tools/harness/harness.py can
        drive the UI and read the screen back. Pulls in the bsp_harness.h
        injection hooks and the libs/image_framework JPEG encoder; leave off in
        production builds. The simulator always has it -- its wifi backend and
        present loop use the harness directly.

endmenu
```
