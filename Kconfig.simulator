## Kconfig.simulator
```kconfig
mainmenu "esp-devkit Simulator Configuration"

config DEVKIT_SIMULATOR
    bool
    default y
    help
        Internal platform marker for Kconfig options that are available only
        in the host simulator build.

config FREERTOS_HZ
    int "FreeRTOS tick rate (Hz)"
    default 100
    help
        configTICK_RATE_HZ of the host FreeRTOS API. Set it to the device's
        value to get the same tick rounding.

menu "Component config"

source "$COMPONENT_KCONFIGS_SOURCE_FILE"

endmenu
```

## bsp/Kconfig
```kconfig
# Board selection for the shared bsp component. ESP-IDF limits the choice to
# boards supported by CONFIG_IDF_TARGET; the simulator can select any board.

menu "Board Support Package"

choice BSP_BOARD
    prompt "Target board"
    default BSP_BOARD_CORE      if DEVKIT_SIMULATOR
    default BSP_BOARD_CORE      if IDF_TARGET_ESP32
    default BSP_BOARD_CORE_S3   if IDF_TARGET_ESP32S3
    default BSP_BOARD_TAB5      if IDF_TARGET_ESP32P4
    default BSP_BOARD_S31_KORVO if IDF_TARGET_ESP32S31

    config BSP_BOARD_CORE
        bool "M5Stack Core (Basic / Core2)"
        depends on DEVKIT_SIMULATOR || IDF_TARGET_ESP32

    config BSP_BOARD_PAPER
        bool "M5Paper (ESP32)"
        depends on DEVKIT_SIMULATOR || IDF_TARGET_ESP32

    config BSP_BOARD_ATOM_LITE
        bool "M5Stack ATOM Lite (ESP32)"
        depends on DEVKIT_SIMULATOR || IDF_TARGET_ESP32

    config BSP_BOARD_STICKC_PLUS
        bool "M5StickC-Plus (ESP32)"
        depends on DEVKIT_SIMULATOR || IDF_TARGET_ESP32

    config BSP_BOARD_CORE_S3
        bool "M5Stack CoreS3 (ESP32-S3)"
        depends on DEVKIT_SIMULATOR || IDF_TARGET_ESP32S3

    config BSP_BOARD_PAPER_S3
        bool "M5PaperS3 (ESP32-S3)"
        depends on DEVKIT_SIMULATOR || IDF_TARGET_ESP32S3

    config BSP_BOARD_LILYGO_T5
        bool "LilyGo T5 ePaper S3 (ESP32-S3)"
        depends on IDF_TARGET_ESP32S3

    config BSP_BOARD_ATOM_S3_LITE
        bool "M5Stack AtomS3 Lite (ESP32-S3)"
        depends on DEVKIT_SIMULATOR || IDF_TARGET_ESP32S3

    config BSP_BOARD_AIRQ
        bool "M5Stack Air Quality Kit (ESP32-S3)"
        depends on DEVKIT_SIMULATOR || IDF_TARGET_ESP32S3

    config BSP_BOARD_TAB5
        bool "M5Stack Tab5 (ESP32-P4)"
        depends on DEVKIT_SIMULATOR || IDF_TARGET_ESP32P4

    config BSP_BOARD_S31_KORVO
        bool "ESP32-S31-Korvo"
        depends on DEVKIT_SIMULATOR || IDF_TARGET_ESP32S31
endchoice

config BSP_M5_HDMI_FPGA_BITSTREAM
    bool "Bundle the HDMI module's FPGA bitstream"
    depends on BSP_BOARD_TAB5 && !DEVKIT_SIMULATOR
    default y
    help
        Link the video module's FPGA gateware into the firmware (~222 KB) so a
        module whose FPGA SRAM is empty -- every cold start -- is loaded over
        JTAG during attach. Turn this off to reclaim the flash, at the cost of
        only working with a module some other host has already loaded.

config BSP_EPD_LL_TWEAK
    bool "epd_ll waveform-tuning backdoor"
    depends on (BSP_BOARD_PAPER_S3 || BSP_BOARD_LILYGO_T5) && !DEVKIT_SIMULATOR
    default n
    help
        Compile the epd_ll waveform-tuning backdoor (epd_ll_tweak.h): swap a
        live panel's waveform LUT over the serial console without a reflash.
        For the epd_tweak development firmware only -- leave off in production.

endmenu
```

## firmware/airq_hello/simulator/sdkconfig.defaults
```kconfig
CONFIG_BSP_BOARD_AIRQ=y
CONFIG_LV_FONT_MONTSERRAT_24=y
CONFIG_LV_FONT_MONTSERRAT_32=y
CONFIG_LV_USE_THEME_DEFAULT=n
CONFIG_LV_USE_THEME_SIMPLE=n
CONFIG_LV_USE_THEME_MONO=y
```

## firmware/core_hello/esp32/sdkconfig.defaults
```kconfig
CONFIG_ESPTOOLPY_FLASHSIZE_4MB=y
CONFIG_COMPILER_OPTIMIZATION_PERF=y
CONFIG_ESP_DEFAULT_CPU_FREQ_MHZ_240=y
CONFIG_FREERTOS_HZ=1000
CONFIG_BSP_BOARD_CORE=y
CONFIG_LV_FONT_MONTSERRAT_16=y
CONFIG_LV_FONT_MONTSERRAT_20=y
CONFIG_LV_FONT_MONTSERRAT_24=y
CONFIG_LV_FONT_MONTSERRAT_32=y
CONFIG_HARNESS=y
```

## firmware/core_s3_hello/esp32s3/sdkconfig.defaults
```kconfig
CONFIG_IDF_TARGET="esp32s3"
CONFIG_BSP_BOARD_CORE_S3=y
CONFIG_ESPTOOLPY_FLASHSIZE_16MB=y
CONFIG_ESP_CONSOLE_USB_SERIAL_JTAG=y
CONFIG_ESP_DEFAULT_CPU_FREQ_MHZ_240=y
CONFIG_FREERTOS_HZ=1000

# LVGL.
CONFIG_LV_FONT_MONTSERRAT_16=y
CONFIG_LV_FONT_MONTSERRAT_20=y
CONFIG_LV_FONT_MONTSERRAT_24=y
CONFIG_LV_FONT_MONTSERRAT_32=y
```

## firmware/core_s3_hello/simulator/sdkconfig.defaults
```kconfig
CONFIG_BSP_BOARD_CORE_S3=y
CONFIG_LV_FONT_MONTSERRAT_16=y
CONFIG_LV_FONT_MONTSERRAT_20=y
CONFIG_LV_FONT_MONTSERRAT_24=y
CONFIG_LV_FONT_MONTSERRAT_32=y
```

## firmware/esp_hosted_enhanced/coprocessor/main/Kconfig.projbuild
```kconfig
menu "Coprocessor"

choice COPROCESSOR_BOARD
    prompt "Board"
    default COPROCESSOR_BOARD_TAB5

config COPROCESSOR_BOARD_TAB5
    bool "M5Stack Tab5 (on-board ESP32-C6)"

config COPROCESSOR_BOARD_XIAO_ESP32C6
    bool "Seeed XIAO ESP32C6 (jumper wired)"

endchoice

endmenu
```

## firmware/esp_hosted_enhanced/coprocessor/sdkconfig.defaults
```kconfig
CONFIG_IDF_TARGET="esp32c6"
CONFIG_ESPTOOLPY_FLASHSIZE_4MB=y
CONFIG_PARTITION_TABLE_CUSTOM=y
CONFIG_PARTITION_TABLE_CUSTOM_FILENAME="partitions.csv"
CONFIG_COMPILER_OPTIMIZATION_PERF=y
CONFIG_FREERTOS_HZ=1000
CONFIG_ESP_WIFI_TX_BA_WIN=32
CONFIG_BT_ENABLED=y
CONFIG_BT_CONTROLLER_ONLY=y
CONFIG_BT_LE_HCI_INTERFACE_USE_RAM=y
```

## firmware/esp_hosted_enhanced/development/esp32p4/main/Kconfig.projbuild
```kconfig
menu "esp_hosted_enhanced development"

config DEV_C6_RECOVERY_GPIO
    int "GPIO wired to the coprocessor's IO2"
    default 14

endmenu
```

## firmware/esp_hosted_enhanced/development/esp32p4/sdkconfig.defaults
```kconfig
CONFIG_IDF_TARGET="esp32p4"
CONFIG_BSP_BOARD_TAB5=y
CONFIG_ESPTOOLPY_FLASHSIZE_16MB=y
CONFIG_PARTITION_TABLE_CUSTOM=y
CONFIG_PARTITION_TABLE_CUSTOM_FILENAME="partitions.csv"
CONFIG_ESP32P4_SELECTS_REV_LESS_V3=y
CONFIG_ESP32P4_REV_MIN_100=y
CONFIG_SPIRAM=y
CONFIG_SPIRAM_SPEED_200M=y
CONFIG_SPIRAM_MEMTEST=n
CONFIG_SPIRAM_TRY_ALLOCATE_WIFI_LWIP=y
CONFIG_COMPILER_OPTIMIZATION_SIZE=y
CONFIG_ESP_CONSOLE_USB_SERIAL_JTAG=y
CONFIG_IDF_EXPERIMENTAL_FEATURES=y
CONFIG_HARNESS=y
CONFIG_LWIP_TCPIP_RECVMBOX_SIZE=64
CONFIG_LWIP_TCP_SND_BUF_DEFAULT=65534
CONFIG_LWIP_TCP_WND_DEFAULT=65534
CONFIG_LWIP_TCP_RECVMBOX_SIZE=48
CONFIG_LWIP_TCP_SACK_OUT=y
CONFIG_ESP_HOSTED_PRIV_SDIO_PIN_CMD_SLOT_1=13
CONFIG_ESP_HOSTED_PRIV_SDIO_PIN_CLK_SLOT_1=12
CONFIG_ESP_HOSTED_PRIV_SDIO_PIN_D0_SLOT_1=11
CONFIG_ESP_HOSTED_PRIV_SDIO_PIN_D1_4BIT_BUS_SLOT_1=10
CONFIG_ESP_HOSTED_PRIV_SDIO_PIN_D2_4BIT_BUS_SLOT_1=9
CONFIG_ESP_HOSTED_PRIV_SDIO_PIN_D3_4BIT_BUS_SLOT_1=8
CONFIG_ESP_HOSTED_SDIO_GPIO_RESET_SLAVE=15
CONFIG_WIFI_RMT_STATIC_RX_BUFFER_NUM=32
CONFIG_WIFI_RMT_DYNAMIC_RX_BUFFER_NUM=64
CONFIG_WIFI_RMT_RX_BA_WIN=32
```

## firmware/esp_hosted_enhanced/development/esp32p4/sdkconfig.defaults.enhanced
```kconfig
CONFIG_ESP_WIFI_REMOTE_LIBRARY_CUSTOM=y
CONFIG_ESP_HOSTED_ENHANCED_PIN_CLK=12
CONFIG_ESP_HOSTED_ENHANCED_PIN_CMD=13
CONFIG_ESP_HOSTED_ENHANCED_PIN_D0=11
CONFIG_ESP_HOSTED_ENHANCED_PIN_D1=10
CONFIG_ESP_HOSTED_ENHANCED_PIN_D2=9
CONFIG_ESP_HOSTED_ENHANCED_PIN_D3=8
CONFIG_ESP_HOSTED_ENHANCED_PIN_RESET=15
```

## firmware/esp_hosted_enhanced/development/esp32p4/sdkconfig.defaults.xiao
```kconfig
CONFIG_ESP_HOSTED_PRIV_SDIO_PIN_CLK_SLOT_1=16
CONFIG_ESP_HOSTED_PRIV_SDIO_PIN_CMD_SLOT_1=17
CONFIG_ESP_HOSTED_PRIV_SDIO_PIN_D0_SLOT_1=2
CONFIG_ESP_HOSTED_PRIV_SDIO_PIN_D1_4BIT_BUS_SLOT_1=3
CONFIG_ESP_HOSTED_PRIV_SDIO_PIN_D2_4BIT_BUS_SLOT_1=4
CONFIG_ESP_HOSTED_PRIV_SDIO_PIN_D3_4BIT_BUS_SLOT_1=45
CONFIG_ESP_HOSTED_SDIO_GPIO_RESET_SLAVE=47
CONFIG_ESP_HOSTED_SDIO_CLOCK_FREQ_KHZ=20000
CONFIG_DEV_C6_RECOVERY_GPIO=51
CONFIG_ESP_HOSTED_ENHANCED_PIN_CLK=16
CONFIG_ESP_HOSTED_ENHANCED_PIN_CMD=17
CONFIG_ESP_HOSTED_ENHANCED_PIN_D0=2
CONFIG_ESP_HOSTED_ENHANCED_PIN_D1=3
CONFIG_ESP_HOSTED_ENHANCED_PIN_D2=4
CONFIG_ESP_HOSTED_ENHANCED_PIN_D3=45
CONFIG_ESP_HOSTED_ENHANCED_PIN_RESET=-1
CONFIG_ESP_HOSTED_ENHANCED_SDIO_FREQ_KHZ=20000
```

## firmware/esp_hosted_enhanced/rust_check/esp32p4/sdkconfig.defaults
```kconfig
CONFIG_IDF_TARGET="esp32p4"
CONFIG_BSP_RS_BOARD_TAB5=y
CONFIG_ESPTOOLPY_FLASHSIZE_16MB=y
CONFIG_PARTITION_TABLE_CUSTOM=y
CONFIG_PARTITION_TABLE_CUSTOM_FILENAME="partitions.csv"
CONFIG_ESP32P4_SELECTS_REV_LESS_V3=y
CONFIG_ESP32P4_REV_MIN_100=y
CONFIG_SPIRAM=y
CONFIG_SPIRAM_SPEED_200M=y
CONFIG_SPIRAM_MEMTEST=n
CONFIG_SPIRAM_TRY_ALLOCATE_WIFI_LWIP=y
CONFIG_COMPILER_OPTIMIZATION_SIZE=y
CONFIG_ESP_CONSOLE_USB_SERIAL_JTAG=y
CONFIG_IDF_EXPERIMENTAL_FEATURES=y
CONFIG_LWIP_TCPIP_RECVMBOX_SIZE=64
CONFIG_LWIP_TCP_SND_BUF_DEFAULT=65534
CONFIG_LWIP_TCP_WND_DEFAULT=65534
CONFIG_LWIP_TCP_RECVMBOX_SIZE=48
CONFIG_LWIP_TCP_SACK_OUT=y
CONFIG_WIFI_RMT_STATIC_RX_BUFFER_NUM=32
CONFIG_WIFI_RMT_DYNAMIC_RX_BUFFER_NUM=64
CONFIG_WIFI_RMT_RX_BA_WIN=32
CONFIG_BT_ENABLED=y
CONFIG_BT_NIMBLE_ENABLED=y
CONFIG_BT_CONTROLLER_DISABLED=y
CONFIG_BT_NIMBLE_TRANSPORT_UART=n
CONFIG_ESP_WIFI_REMOTE_LIBRARY_CUSTOM=y
```

## firmware/imgf_bench/esp32p4/sdkconfig.defaults
```kconfig
CONFIG_IDF_TARGET="esp32p4"
CONFIG_ESPTOOLPY_FLASHSIZE_16MB=y
CONFIG_PARTITION_TABLE_CUSTOM=y
CONFIG_PARTITION_TABLE_CUSTOM_FILENAME="partitions.csv"
CONFIG_PARTITION_TABLE_OFFSET=0x10000
CONFIG_ESP32P4_SELECTS_REV_LESS_V3=y
CONFIG_ESP32P4_REV_MIN_100=y
CONFIG_SPIRAM=y
CONFIG_SPIRAM_MODE_HEX=y
CONFIG_SPIRAM_SPEED_200M=y
CONFIG_SPIRAM_MEMTEST=n
CONFIG_ESP_DEFAULT_CPU_FREQ_MHZ_360=y
# Match what the sample apps build at, so the numbers are an app's numbers.
CONFIG_COMPILER_OPTIMIZATION_SIZE=y
CONFIG_ESP_MAIN_TASK_STACK_SIZE=8192
CONFIG_ESP_CONSOLE_USB_SERIAL_JTAG=y
CONFIG_ESP_TASK_WDT_INIT=n
CONFIG_IDF_EXPERIMENTAL_FEATURES=y
```

## firmware/lwip_netbench/esp32s3/sdkconfig.defaults
```kconfig
CONFIG_IDF_TARGET="esp32s3"
CONFIG_BSP_RS_BOARD_ATOM_S3_LITE=y
CONFIG_ESPTOOLPY_FLASHSIZE_8MB=y
CONFIG_PARTITION_TABLE_SINGLE_APP_LARGE=y
CONFIG_ESP_CONSOLE_USB_SERIAL_JTAG=y
CONFIG_ESP_DEFAULT_CPU_FREQ_MHZ_240=y
CONFIG_FREERTOS_HZ=1000
CONFIG_ESP_MAIN_TASK_STACK_SIZE=16384
CONFIG_LWIP_TCPIP_RECVMBOX_SIZE=64
CONFIG_LWIP_TCP_SND_BUF_DEFAULT=65534
CONFIG_LWIP_TCP_WND_DEFAULT=65534
CONFIG_LWIP_TCP_RECVMBOX_SIZE=48
CONFIG_LWIP_TCP_SACK_OUT=y
CONFIG_ESPTOOLPY_FLASHMODE_QIO=y
```

## firmware/rust_hello/esp32s3/sdkconfig.defaults
```kconfig
CONFIG_IDF_TARGET="esp32s3"
CONFIG_BSP_RS_BOARD_ATOM_S3_LITE=y
CONFIG_ESPTOOLPY_FLASHSIZE_8MB=y
CONFIG_ESP_CONSOLE_USB_SERIAL_JTAG=y
CONFIG_ESP_DEFAULT_CPU_FREQ_MHZ_240=y
CONFIG_FREERTOS_HZ=1000
CONFIG_ESP_WIFI_ENTERPRISE_SUPPORT=n
CONFIG_ESP_MAIN_TASK_STACK_SIZE=16384
CONFIG_ESPTOOLPY_FLASHMODE_QIO=y
CONFIG_DEVKIT_NET_IRAM_OPT=y
CONFIG_PARTITION_TABLE_SINGLE_APP_LARGE=y
```

## firmware/s31_korvo_hello/simulator/sdkconfig.defaults
```kconfig
CONFIG_BSP_BOARD_S31_KORVO=y
CONFIG_LV_FONT_MONTSERRAT_24=y
CONFIG_LV_FONT_MONTSERRAT_32=y
CONFIG_LV_FONT_MONTSERRAT_48=y
```

## firmware/ui_test/paper/sdkconfig.defaults
```kconfig
CONFIG_BSP_BOARD_PAPER_S3=y
CONFIG_LV_FONT_MONTSERRAT_24=y
CONFIG_LV_FONT_MONTSERRAT_32=y
CONFIG_LV_FONT_MONTSERRAT_48=y
CONFIG_LV_USE_THEME_DEFAULT=n
CONFIG_LV_USE_THEME_SIMPLE=n
CONFIG_LV_USE_THEME_MONO=y
```

## firmware/usbd_loopback/esp32p4/sdkconfig.defaults
```kconfig
CONFIG_IDF_TARGET="esp32p4"
CONFIG_ESPTOOLPY_FLASHSIZE_16MB=y
CONFIG_ESP32P4_SELECTS_REV_LESS_V3=y
CONFIG_ESP32P4_REV_MIN_100=y
CONFIG_IDF_EXPERIMENTAL_FEATURES=y
CONFIG_ESP_CONSOLE_USB_SERIAL_JTAG=y
CONFIG_USBD=y
CONFIG_USBD_VENDOR=y
```
